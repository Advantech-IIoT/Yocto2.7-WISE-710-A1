## conf/layer.conf
```bitbake
# We have a conf and classes directory, add to BBPATH
BBPATH .= ":${LAYERDIR}"

# We have recipes-* directories, add to BBFILES
BBFILES += "${LAYERDIR}/recipes-*/*/*.bb \
	${LAYERDIR}/recipes-*/*/*.bbappend"

BBFILE_COLLECTIONS += "wise710a1"
BBFILE_PATTERN_wise710a1 = "^${LAYERDIR}/"
BBFILE_PRIORITY_wise710a1 = "12"

LAYERSERIES_COMPAT_wise710a1 = "warrior"
```

## conf/machine/imx6dlwise710a1.conf
```bitbake
#@TYPE: Machine
#@NAME: NXP i.MX6DL SABRE Smart Device
#@SOC: i.MX6DL
#@DESCRIPTION: Machine configuration for NXP i.MX6DL SABRE Smart Device
#@MAINTAINER: Otavio Salvador <otavio@ossystems.com.br>

MACHINEOVERRIDES =. "mx6:mx6dl:"

require conf/machine/include/imx6sabresd-common.inc
require conf/machine/include/advantech-default-settings.inc

#KERNEL_DEVICETREE = "imx6dl-wise710-a1.dtb imx6dl-sabresd.dtb imx6dl-sabresd-ldo.dtb imx6dl-sabresd-hdcp.dtb \
#                     imx6dl-sabresd-enetirq.dtb imx6dl-sabresd-btwifi.dtb"

KERNEL_DEVICETREE = "imx6dl-wise710-a1.dtb"

MACHINE_FEATURES_append = " optee"

UBOOT_CONFIG ??= "${@bb.utils.contains('COMBINED_FEATURES', 'optee', 'sd-optee', 'sd', d)}"
UBOOT_CONFIG[sd] = "mx6dlsabresd_config,sdcard"
UBOOT_CONFIG[epdc] = "mx6dlsabresd_epdc_config"
UBOOT_CONFIG[mfgtool] = "mx6dlsabresd_config"
UBOOT_CONFIG[sd-optee] = "mx6dlsabresd_optee_config,sdcard"

UBOOT_CONFIG[1G] = "mx6dlwise710a1_1G_config,sdcard"
UBOOT_CONFIG[2G] = "mx6dlwise710a1_2G_config,sdcard"

OPTEE_BIN_EXT = "6dlsdb"

MACHINE_FIRMWARE += "firmware-imx-epdc"

# SDCARD_ROOTFS = "${DEPLOY_DIR_IMAGE}/${IMAGE_NAME}.rootfs.ext4"
SDCARD_ROOTFS = "${IMGDEPLOYDIR}/${IMAGE_NAME}${IMAGE_NAME_SUFFIX}.ext4"
# IMAGE_FSTYPES = "tar.bz2 ext4"
IMAGE_FSTYPES = "tar.bz2 ext4 sdcard"
# IMAGE_FSTYPES_DEBUGFS = "${IMAGE_FSTYPES}"

BOOT_SPACE = "16384"
```

## meta-bsp-patch/conf/layer.conf
```bitbake
# We have a conf and classes directory, add to BBPATH
BBPATH .= ":${LAYERDIR}"

# We have recipes-* directories, add to BBFILES
BBFILES += "${LAYERDIR}/recipes-*/*/*.bb \
            ${LAYERDIR}/recipes-*/*/*.bbappend"

BBFILE_COLLECTIONS += "meta-bsp-patch"
BBFILE_PATTERN_meta-bsp-patch = "^${LAYERDIR}/"
BBFILE_PRIORITY_meta-bsp-patch = "12"

LAYERDEPENDS_meta-bsp-patch = "core"
LAYERSERIES_COMPAT_meta-bsp-patch = "warrior"
```
